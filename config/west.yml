## config/west.yml
```yaml
manifest:
  remotes:
    - name: zmkfirmware
      url-base: https://github.com/zmkfirmware
    # - name: englmaxi
    #   url-base: https://github.com/englmaxi
    # - name: urob
    #   url-base: https://github.com/urob
  projects:
    - name: zmk
      remote: zmkfirmware
      revision: main
      import: app/west.yml
    # - name: zmk-dongle-display
    #   remote: englmaxi
    #   revision: main
    # - name: zmk-helpers
    #   remote: urob
    #   revision: main
  self:
    path: config
```
